//#include <Wire.h>
#include <VL53L0X.h>
//#include "SPI.h"
//#include <Adafruit_GrayOLED.h>
#include <Adafruit_SH1106.h>
//#include <Adafruit_NeoPixel.h>
//#include <Keyboard.h>
#include "RTClib.h"
//#include <U8g2lib.h>
//#include "timer.h"

#define BUTTON_UP 10
#define BUTTON_CENTER 9
#define BUTTON_DOWN 8

#define BUZZER 12
#define LASER 13
#define PIXEL_COUNT 1
#define PIXEL_PIN   6

#define TRUE 1


Adafruit_SH1106 display(7);
VL53L0X sensor;
//Adafruit_NeoPixel strip = Adafruit_NeoPixel(PIXEL_COUNT, PIXEL_PIN, NEO_GRB + NEO_KHZ800);
//auto timer = timer_create_default();
RTC_DS3231 rtc;

// '00000250', 128x64px
const unsigned char reimuImage [] PROGMEM = {
  0xff, 0xff, 0xff, 0xff, 0xff, 0xff, 0xff, 0xff, 0xff, 0xff, 0xff, 0xff, 0xff, 0xff, 0xff, 0xff, 
  0xff, 0xff, 0xff, 0xff, 0xff, 0xff, 0xff, 0xff, 0xff, 0xff, 0xff, 0xff, 0xff, 0xff, 0xff, 0xff, 
  0xff, 0xff, 0xff, 0xff, 0xff, 0xff, 0xff, 0xff, 0xff, 0xff, 0xff, 0xff, 0xff, 0xff, 0xff, 0xff, 
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  0xff, 0xff, 0xff, 0xfc, 0x00, 0x00, 0x00, 0x00, 0x01, 0xff, 0xff, 0xff, 0xff, 0xff, 0xff, 0xff
};


const char* daysOfTheWeek[7] = {"Sunday", "Monday", "Tuesday", "Wednesday", "Thursday", "Friday", "Saturday"};
boolean button_down_now_state = HIGH;
boolean button_down_old_state = LOW;
boolean laser_state = HIGH;
boolean isRtc = true;

int pic = 0;
const int maxPics = 4;

void setup() {
  Wire.begin();
  rtc.begin(); //starts rtc chip
  rtc.adjust(DateTime(F(__DATE__), F(__TIME__)));
  sensor.init(); //initalize sensor 
  sensor.setTimeout(500); //sets distance sensor reading timing
  sensor.startContinuous(); //sets distance sensor reading

  pinMode(BUTTON_UP,INPUT_PULLUP);
  pinMode(BUTTON_CENTER,INPUT_PULLUP);
  pinMode(BUTTON_DOWN,INPUT_PULLUP);
  pinMode(BUZZER,OUTPUT);
  pinMode(LASER,OUTPUT);
  pinMode(PIXEL_PIN,OUTPUT);
  
  display.begin(SH1106_SWITCHCAPVCC, 0x3C);
  display.setTextColor(WHITE);

  delay(2000);
}

void loop() {
  //timer.tick();
  if (pic == 0)
{
  DateTime now = rtc.now();
  display.setTextSize(3);
  display.setCursor(0,0);
  display.print(now.twelveHour(), DEC);
  display.print(':');
  display.print(now.minute(), DEC);
  display.setTextSize(1);
  display.setCursor(75,0);
  display.print(now.second(), DEC);
  display.setCursor(80,15);
  if (now.isPM() == TRUE) {
    display.print("PM");
  }
  else {
    display.print("AM");
  }
  display.println();
  display.setCursor(0,30);
  display.print(now.year(), DEC);
  display.print('/');
  display.print(now.month(), DEC);
  display.print('/');
  display.print(now.day(), DEC);
  display.print(' ');
  display.print(daysOfTheWeek[now.dayOfTheWeek()]);
  display.setCursor(0,40);
  display.print("Temperature: ");
  display.print(rtc.getTemperature());
  display.print(" C");
  display.setCursor(0,50);
  display.print("Distance");
  display.print(':');
  display.print(sensor.readRangeContinuousMillimeters());
  display.print("MM");
}
else {
// pic = 1,2,3,4
const char* items[maxPics] = {"CLOCK", "BAD APPLE", "EXECUTE BAD USB", "LASER TOGGLE"};
//header
  display.setTextSize(1);
  display.setCursor(22,0);  
  display.print("badMenu!!");
  display.drawLine (0,9,128,9, WHITE);
int i;
for (i = 0; i <= 3; i++) {
    display.setCursor(0, 11 + 9 * i);
    if (i == pic-1) {
        display.print(">");
    } else {
        display.print(" ");
    }
    display.print(items[i]);
}
}
refresh();

if (digitalRead(BUTTON_DOWN) == LOW) {
    if (pic >= maxPics) {
        pic = 1;
    } 
    else {
        pic += 1;
    }
}

if (digitalRead(BUTTON_UP) == LOW) {
    if (pic == 1) {
        pic = maxPics;
    } 
    else {
        pic -= 1;
    }
}


if (digitalRead(BUTTON_CENTER)==LOW)
{
    if (pic == 1)
    {
      pic=0;
    }
    else if(pic == 2)
    {
      badApple();
    }
    else if(pic == 3)
    {
      badUSB();
    }
    else if(pic == 4)
    {
      laser();
    }
}

} //end loop

static const uint16_t Melody0[] PROGMEM = { 
        0b1110111101010011, 0b1111000101010101, 0b1110111101010110, 0b1111000101011000, 
        0b1111111101011010, 0b1110000101011010, 0b1110111101010011, 0b1111000101100001, 
        0b1111111101011010, 0b1110000101011010, 0b1111111101010011, 0b1110000101010011, 
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        0b1111111101010011, 0b1111111101010011, 0b1111111101010011, 0b1111111101010011, 
  };
  
static const uint16_t Melody0_Length    = sizeof( Melody0 ) / sizeof(uint16_t);

void badApple()
{
      display.drawBitmap(0, 0, reimuImage, 128, 64, WHITE); 
      refresh();
      uint8_t tempo = 1;
      playMelody_Data(Melody0, Melody0_Length, tempo); 
      noTone(BUZZER);
}

void playMelody_Data(const uint16_t MelodyData[], const uint16_t MelodyLength, const uint8_t tempo)
{
  // 8th Octave Frequencies C8 to B8, lower octaves are calculated from this
  static const uint16_t Freq8[] PROGMEM = { 4186 , 4435 , 4699  , 4978 , 5274 , 5588 , 5920 , 6272 , 6645 , 7040 , 7459 , 7902 };

  for(uint16_t  x = 0; x < MelodyLength; x++)
  {
    uint16_t data = pgm_read_word((uint16_t *)&MelodyData[x]);
    if((data & 0xF) == 0xF) 
    {
      noTone(BUZZER);
    }
    else
    {
      uint16_t Freq = pgm_read_word(&Freq8[data&0xF]) / ( 1 << (8-(data>>4 & 0xF)) );
      tone(BUZZER, Freq);    

    }    
    
    int16_t Duration = data>>8;
    while(Duration--) delay(tempo);
  }
}

void refresh()
{
  display.display();
  display.clearDisplay();
}

void laser()
{
      laser_state = !laser_state;                        //switch state: true <-> false
      digitalWrite(LASER, laser_state);
      delay(500);
}

void badUSB()
{
  delay(100);
}
